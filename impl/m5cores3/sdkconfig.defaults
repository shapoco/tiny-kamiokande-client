## impl/m5cores3/sdkconfig.defaults
```kconfig
# M5Stack CoreS3 (ESP32-S3)
CONFIG_IDF_TARGET="esp32s3"
CONFIG_ESP_DEFAULT_CPU_FREQ_MHZ_240=y
CONFIG_ESPTOOLPY_FLASHSIZE_16MB=y
# USB-C はチップ内蔵の USB-Serial/JTAG につながっている
CONFIG_ESP_CONSOLE_USB_SERIAL_JTAG=y

CONFIG_ESPTOOLPY_FLASHMODE_QIO=y
CONFIG_ESP32S3_DATA_CACHE_64KB=y
CONFIG_ESP32S3_DATA_CACHE_LINE_64B=y
CONFIG_ESP32S3_INSTRUCTION_CACHE_32KB=y

# CoreS3 の PSRAM は quad。履歴と App を置く
CONFIG_SPIRAM=y
CONFIG_SPIRAM_MODE_QUAD=y
CONFIG_SPIRAM_SPEED_80M=y
CONFIG_SPIRAM_IGNORE_NOTFOUND=y
# WiFi と lwIP のバッファ、mbedTLS は PSRAM から取って内蔵 RAM を描画に残す
CONFIG_SPIRAM_TRY_ALLOCATE_WIFI_LWIP=y
CONFIG_MBEDTLS_EXTERNAL_MEM_ALLOC=y
# 推定タスクのスタックを PSRAM に置く
CONFIG_SPIRAM_ALLOW_STACK_EXTERNAL_MEMORY=y
CONFIG_ESP_WIFI_STATIC_RX_BUFFER_NUM=6

# 描画はメインタスク (core0)。WiFi と lwIP は推定と同じ core1 に置く
CONFIG_ESP_WIFI_TASK_PINNED_TO_CORE_1=y
CONFIG_LWIP_TCPIP_TASK_AFFINITY_CPU1=y

CONFIG_COMPILER_OPTIMIZATION_PERF=y
CONFIG_FREERTOS_HZ=1000
CONFIG_ESP_MAIN_TASK_STACK_SIZE=16384
# core0 は描画で占有されアイドルタスクが回らないため
CONFIG_ESP_TASK_WDT_INIT=n

# HTTPS (api.php) の証明書
CONFIG_MBEDTLS_CERTIFICATE_BUNDLE=y
CONFIG_MBEDTLS_CERTIFICATE_BUNDLE_DEFAULT_CMN=y

CONFIG_PARTITION_TABLE_CUSTOM=y
CONFIG_PARTITION_TABLE_CUSTOM_FILENAME="partitions.csv"

# 使わない画素形式と機能
CONFIG_SHAPOGFX_FORMAT_GRAY1=n
CONFIG_SHAPOGFX_FORMAT_RGB444=n
CONFIG_SHAPOGFX2D_RIG=n
CONFIG_SHAPOGFX2D_LVGL_FONT=n

# テクスチャの遠近補正はスパンの両端で正確 (既定のレベル 1)。描画時間はスパン数に比例するので分割数で調整する
CONFIG_SHAPOGFX3D_CORRECT_PERSPECTIVE=1
# 頂点処理は固定小数のほうが速い (float の割り算が遅いため)
CONFIG_SHAPOGFX3D_FIXED_POINT=y
```
